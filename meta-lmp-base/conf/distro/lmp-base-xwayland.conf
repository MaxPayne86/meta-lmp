## meta-lmp-base/conf/distro/lmp-base-xwayland.conf
```bitbake
require conf/distro/lmp-base.conf

DISTRO = "lmp-base-xwayland"
DISTROOVERRIDES = "lmp:lmp-base:lmp-wayland:lmp-xwayland:lmp-base-wayland:lmp-base-xwayland"
DISTRO_NAME = "Linux-microPlatform Base (no ostree) XWayland"

DISTRO_FEATURES:append = " x11 wayland opengl vulkan"

# meta-freescale: remove append which drops x11 from gtk+3 PACKAGECONFIG if wayland is selected
BBMASK += " \
    /meta-freescale/recipes-graphics/gtk\+/gtk\+3_%.bbappend \
"
```
